/**
 * @cliArgs --board "/ti/boards/LP_CC2651P3" --rtos "tirtos7" --product "simplelink_cc13xx_cc26xx_sdk@7.10.01.24"
 * @versions {"tool":"1.16.2+3028"}
 */

/**
 * Import the modules used in this configuration.
 */
const CCFG         = scripting.addModule("/ti/devices/CCFG");
const rfdesign     = scripting.addModule("/ti/devices/radioconfig/rfdesign");
const Display      = scripting.addModule("/ti/display/Display");
const Display1     = Display.addInstance();
const AESCCM       = scripting.addModule("/ti/drivers/AESCCM");
const AESCCM1      = AESCCM.addInstance();
const GPIO         = scripting.addModule("/ti/drivers/GPIO");
const GPIO5        = GPIO.addInstance();
const GPIO6        = GPIO.addInstance();
const GPIO7        = GPIO.addInstance();
const GPIO8        = GPIO.addInstance();
const NVS          = scripting.addModule("/ti/drivers/NVS");
const NVS1         = NVS.addInstance();
const Power        = scripting.addModule("/ti/drivers/Power");
const RF           = scripting.addModule("/ti/drivers/RF");
const Settings     = scripting.addModule("/ti/posix/tirtos/Settings");
const BIOS         = scripting.addModule("/ti/sysbios/BIOS");
const Boot         = scripting.addModule("/ti/sysbios/family/arm/cc26xx/Boot");
const Hwi          = scripting.addModule("/ti/sysbios/family/arm/m3/Hwi");
const GateMutexPri = scripting.addModule("/ti/sysbios/gates/GateMutexPri");
const HeapCallback = scripting.addModule("/ti/sysbios/heaps/HeapCallback");
const Clock        = scripting.addModule("/ti/sysbios/knl/Clock");
const Idle         = scripting.addModule("/ti/sysbios/knl/Idle");
const Idle1        = Idle.addInstance();
const Semaphore    = scripting.addModule("/ti/sysbios/knl/Semaphore");
const Swi          = scripting.addModule("/ti/sysbios/knl/Swi");
const Task         = scripting.addModule("/ti/sysbios/knl/Task");
const Error        = scripting.addModule("/ti/sysbios/runtime/Error");
const Memory       = scripting.addModule("/ti/sysbios/runtime/Memory");
const SysCallback  = scripting.addModule("/ti/sysbios/runtime/SysCallback");
const System       = scripting.addModule("/ti/sysbios/runtime/System");
const ti154stack   = scripting.addModule("/ti/ti154stack/ti154stack");

/**
 * Write custom configuration values to the imported modules.
 */
CCFG.enableBootloader         = true;
CCFG.enableBootloaderBackdoor = true;
CCFG.dioBootloaderBackdoor    = 13;
CCFG.levelBootloaderBackdoor  = "Active low";
CCFG.forceVddr                = true;
CCFG.ccfgTemplate.$name       = "ti_devices_CCFG_CCFGCC26XXTemplate0";

Display1.$hardware  = system.deviceData.board.components.XDS110UART;
Display1.$name      = "CONFIG_DISPLAY";
Display1.uart.$name = "CONFIG_DISPLAY_UART";

AESCCM1.$name = "CONFIG_AESCCM_0";

GPIO5.$hardware = system.deviceData.board.components.LED_RED;
GPIO5.$name     = "CONFIG_GPIO_RLED";

GPIO6.$hardware = system.deviceData.board.components.LED_GREEN;
GPIO6.$name     = "CONFIG_GPIO_GLED";

GPIO7.$hardware = system.deviceData.board.components["BTN-1"];
GPIO7.pull      = "Pull Up";
GPIO7.$name     = "CONFIG_GPIO_BTN1";

GPIO8.$hardware = system.deviceData.board.components["BTN-2"];
GPIO8.pull      = "Pull Up";
GPIO8.$name     = "CONFIG_GPIO_BTN2";

NVS1.$name                    = "CONFIG_NVSINTERNAL";
NVS1.internalFlash.$name      = "ti_drivers_nvs_NVSCC26XX0";
NVS1.internalFlash.regionBase = 0x4E000;
NVS1.internalFlash.regionSize = 0x8000;

RF.$hardware = system.deviceData.board.components.RTC6608OU;

BIOS.assertsEnabled = false;
BIOS.rtsGateType    = "BIOS_GateMutexPri";
BIOS.heapSize       = 0x00000000;
BIOS.heapType       = "HeapCallback";

Hwi.excHandlerFunc = "Main_excHandler";
Hwi.nvicCCR        = [];

HeapCallback.initFxn           = "osalHeapInitFxn";
HeapCallback.allocInstFxn      = "osalHeapAllocFxn";
HeapCallback.freeInstFxn       = "osalHeapFreeFxn";
HeapCallback.getStatsInstFxn   = "osalHeapGetStatsFxn";
HeapCallback.isBlockingInstFxn = "osalHeapIsBlockingFxn";

Clock.tickPeriod  = 10;
Clock.swiPriority = 4;

const Timer = scripting.addModule("/ti/sysbios/family/arm/cc26xx/Timer", {}, false);

Idle1.$name   = "powerIdle";
Idle1.idleFxn = "Power_idleFunc";

Semaphore.supportsPriority = false;

Swi.numPriorities = 6;

Task.checkStackFlag    = false;
Task.defaultStackSize  = 512;
Task.idleTaskStackSize = 512;
Task.numPriorities     = 6;

Error.policy = "Error_SPIN";

System.abortFxn          = "System_abortSpin";
System.exitFxn           = "System_exitSpin";
System.maxAtexitHandlers = 1;
System.supportModule     = "SysCallback";

ti154stack.project                                             = "coprocessor";
ti154stack.lockProject                                         = true;
ti154stack.coexSettings.$name                                  = "ti_ti154stack_rf_config_ti154stack_coex_mod0";
ti154stack.aesccmModule.$name                                  = "CONFIG_AESCCM_1";
ti154stack.ti154stackOpts.$name                                = "ti_ti154stack_ti154stack_config_opts0";
ti154stack.radioConfig250KbpsIeee802154.codeExportConfig.$name = "ti_devices_radioconfig_code_export_param0";

/**
 * Pinmux solution for unlocked pins/peripherals. This ensures that minor changes to the automatic solver in a future
 * version of the tool will not impact the pinmux you originally saw.  These lines can be completely deleted in order to
 * re-solve from scratch.
 */
Display1.uart.uart.$suggestSolution       = "UART0";
Display1.uart.uart.txPin.$suggestSolution = "boosterpack.4";
Display1.uart.uart.rxPin.$suggestSolution = "boosterpack.3";
GPIO5.gpioPin.$suggestSolution            = "boosterpack.39";
GPIO6.gpioPin.$suggestSolution            = "boosterpack.40";
GPIO7.gpioPin.$suggestSolution            = "boosterpack.13";
GPIO8.gpioPin.$suggestSolution            = "boosterpack.12";
RF.rfAntennaPin0.$suggestSolution         = "DIO_28";
RF.rfAntennaPin1.$suggestSolution         = "DIO_29";
Timer.rtc.$suggestSolution                = "RTC0";
